## Kconfig
```kconfig
# Main Kconfig file
mainmenu "My Project Configuration"

# Version configuration
config PROJECT_VERSION_MAJOR
    int "Major version"
    default 1

config PROJECT_VERSION_MINOR
    int "Minor version"
    default 0

# Debug menu - completely contained in this file
menu "Debug options"
    config DEBUG
        bool "Enable debugging"
        default n
        help
          Enable debug output and assertions

    config VERBOSE_LOGGING
        bool "Enable verbose logging"
        depends on DEBUG
        default n
        help
          Enable more detailed logging output
endmenu

# Include other Kconfig files
source "config/Kconfig.features"
```

## config/Kconfig.features
```kconfig
# File: config/Kconfig.features
menu "Feature Configuration"

config NETWORKING
    bool "Enable networking support"
    default n
    help
      Enable basic networking capabilities

if NETWORKING

config TCP_SUPPORT
    bool "TCP protocol support"
    default y
    help
      Enable TCP protocol support

config UDP_SUPPORT
    bool "UDP protocol support"
    default y
    help
      Enable UDP protocol support

endif # NETWORKING

config ENABLE_SERVER
    bool "Enable server functionality"
    depends on NETWORKING && TCP_SUPPORT
    default n
    help
      Enables server functionality

config FILE_OPERATIONS
    bool "Enable file operations"
    default y
    help
      Enable file read/write operations

endmenu
```
